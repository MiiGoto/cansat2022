#include "GPS.h"

TinyGPSPlus gps;
SoftwareSerial gps_Serial(4, 2); // TXD, RXD

GPS::GPS(){}

void GPS::setup(){
  // Serial.print("GPS setupping...");
  gps_Serial.begin(9600);
  while (!gps_Serial.available()) {
    ; // wait GPS to connect.
  }
  // 本当はここにGPSがちゃんと更新されているかを確かめるトラップコードが欲しいが、うまく動かなかった
  // 野外ならすぐにGPS拾い始めると思うけど、祈っておいてください
  // while(1){
  //   char c = gps_Serial.read();
  //   gps.encode(c);
  //   if (gps.location.isUpdated()) {
  //     return;
  //   }
  //   delay(100);
  // }
}

// @ metersは念のため取得してるけど、使わない(使えない)と思う.
// @  時刻のデータを取得するコードを追加する
void GPS::readSenser(double *lat, double *lng, double *meters){
  // Serial.println("GPS data getting... ");
  loop_count = 0;
  for (loop_count = 0; loop_count < 100000; loop_count++) {
    while (gps_Serial.available() > 0) {
      char c = gps_Serial.read();
      //// Serial.print(c);
      gps.encode(c);
      if (gps.location.isUpdated()){
        // Serial.print("LAT="); // Serial.println(gps.location.lat(), 6);
        // Serial.print("LONG="); // Serial.println(gps.location.lng(), 6);
        // Serial.print("ALT="); // Serial.println(gps.altitude.meters());
        *lat = gps.location.lat();
        *lng = gps.location.lng();
        *meters = gps.altitude.meters();
        // Serial.println("GPS data getting is DONE!!   \n");
        return;
      }
    }
  }
  return;
}






/*
//this function is generated by Copilot
void GPS::writeSD(String data){
  if(!SD.begin(10)){
    // Serial.println("SD-Card is not found!");
  }else{
    File dataFile = SD.open("data.txt", FILE_WRITE);
    if(dataFile){
      dataFile.println(data);
      dataFile.close();
    }else{
      // Serial.println("faile to write data");
    }
  }
}
*/
